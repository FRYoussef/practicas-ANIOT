## practica2/src/Kconfig.projbuild
```kconfig
menu "PR2 configuration"
    config S1_MILLIS
    int "Number of milliseconds that sensor task 1 should sample"
    range 1 10000
    default 100

    config S2_MILLIS
    int "Number of milliseconds that sensor task 2 should sample"
    range 1 10000
    default 100

    config QUEUE_SIZE
    int "The size of the queue events"
    range 1 20
    default 5

    config TASK_INFO_DELAY
    int "Task information delay in seconds"
    range 1 100
    default 10

endmenu
```

## practica4/src/Kconfig.projbuild
```kconfig
menu "PR4 configuration"
    config QUEUE_SIZE
    int "The size of the queue events"
    range 1 20
    default 5

    config CHRONO_TIME
    int "Chronometer time in microseconds"
    range 100 10000000
    default 1000000

    config RESET_POLLING_TIME
    int "Reset polling time in milliseconds"
    range 10 1000
    default 100

    config HALL_THRESHOLD
    int "Hall sensor threshold"
    default 0

    config ENABLE_HALL_SENSOR
    bool "True enables hall sensor. False enables infrared sensor"
    default True

endmenu
```

## practica6/src/Kconfig.projbuild
```kconfig
menu "PR6 configuration"
    config TIMER_DELAY
    int "Timer wake up delay in micro-seconds"
    range 100000 100000000
    default 10000000

    config SAMPLE_DELAY
    int "Sample delay in ms"
    range 100 100000
    default 1000

    choice SLEEP
        prompt "Select sleep mode"
        default LIGHT_SLEEP

        config LIGHT_SLEEP
            bool "Enable light sleep mode"
        config DEEP_SLEEP
            bool "Enable deep sleep mode"
        config NON_SLEEP
            bool "Non-sleep mode"
    endchoice

    choice EXAMPLE_MAX_CPU_FREQ
        prompt "Maximum CPU frequency"
        default EXAMPLE_MAX_CPU_FREQ_240
        help
            Maximum CPU frequency to use for dynamic frequency scaling.

        config EXAMPLE_MAX_CPU_FREQ_80
            bool "80 MHz"
        config EXAMPLE_MAX_CPU_FREQ_160
            bool "160 MHz"
        config EXAMPLE_MAX_CPU_FREQ_240
            bool "240 MHz"
    endchoice

    config MAX_CPU_FREQ_MHZ
        int
        default 80 if EXAMPLE_MAX_CPU_FREQ_80
        default 160 if EXAMPLE_MAX_CPU_FREQ_160
        default 240 if EXAMPLE_MAX_CPU_FREQ_240


    choice EXAMPLE_MIN_CPU_FREQ
        prompt "Minimum CPU frequency"
        default EXAMPLE_MIN_CPU_FREQ_40M
        help
            Minimum CPU frequency to use for dynamic frequency scaling.

        config EXAMPLE_MIN_CPU_FREQ_40M
            bool "40 MHz"
        config EXAMPLE_MIN_CPU_FREQ_20M
            bool "20 MHz"
        config EXAMPLE_MIN_CPU_FREQ_10M
            bool "10 MHz"
        config EXAMPLE_MIN_CPU_FREQ_26M
            bool "26 MHz"
        config EXAMPLE_MIN_CPU_FREQ_13M
            bool "13 MHz"
    endchoice

    config MIN_CPU_FREQ_MHZ
        int
        default 40 if EXAMPLE_MIN_CPU_FREQ_40M
        default 20 if EXAMPLE_MIN_CPU_FREQ_20M
        default 10 if EXAMPLE_MIN_CPU_FREQ_10M
        default 26 if EXAMPLE_MIN_CPU_FREQ_26M
        default 13 if EXAMPLE_MIN_CPU_FREQ_13M
endmenu
```

## practica7/src/Kconfig.projbuild
```kconfig
menu "PR7 configuration"
    config TIMER_DELAY
    int "Timer delay to take samples (in micro-seconds)."
    range 100000 100000000
    default 10000000

    config TIME_TO_STOP
    int "Number of seconds which the aplication has to take samples."
    range 1 3600
    default 60

    config SHOW_N_SAMPLES
    int "The number of samples the application has to show before finishing its execution."
    range 1 10
    default 5
endmenu
```
